## board/freescale/mx6q_iTop/Kconfig
```kconfig
if TARGET_MX6Q_ITOP

config SYS_BOARD
	default "mx6q_iTop"

config SYS_VENDOR
	default "freescale"

config SYS_CONFIG_NAME
	default "mx6q_iTop"

endif
```

## configs/mx6qiTop_defconfig
```kconfig
CONFIG_SYS_EXTRA_OPTIONS="IMX_CONFIG=board/freescale/mx6q_iTop/mx6q_iTop.cfg,MX6Q"
CONFIG_ARM=y
CONFIG_ARCH_MX6=y
CONFIG_TARGET_MX6Q_ITOP=y
CONFIG_SYS_MALLOC_F=y
CONFIG_SYS_MALLOC_F_LEN=0x400
CONFIG_DM=y
CONFIG_DM_THERMAL=y
```
